## config/boards/shields/enlil36/Kconfig.defconfig
```kconfig
# Copyright (c) 2020 The ZMK Contributors
# SPDX-License-Identifier: MIT

if SHIELD_ENLIL36_LEFT

config ZMK_KEYBOARD_NAME
	default "Enlil36"

config ZMK_SPLIT_BLE_ROLE_CENTRAL
	default y

endif

if SHIELD_ENLIL36_LEFT || SHIELD_ENLIL36_RIGHT

config ZMK_SPLIT
	default y

endif
```

## config/boards/shields/enlil36/Kconfig.shield
```kconfig
# Copyright (c) 2020 The ZMK Contributors
# SPDX-License-Identifier: MIT

config SHIELD_ENLIL36_LEFT
	def_bool $(shields_list_contains,enlil36_left)

config SHIELD_ENLIL36_RIGHT
	def_bool $(shields_list_contains,enlil36_right)
```
